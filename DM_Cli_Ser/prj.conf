## CMakeLists.txt
```
#
# Copyright (c) 2019 Nordic Semiconductor ASA
#
# SPDX-License-Identifier: LicenseRef-Nordic-5-Clause
#
cmake_minimum_required(VERSION 3.20.0)

find_package(Zephyr REQUIRED HINTS $ENV{ZEPHYR_BASE})
project(DM_Cli_Ser)

# NORDIC SDK APP START
target_sources(app PRIVATE
	src/main.c
	src/model_handler.c
	src/distance_measurement_handler.c
	src/Sensor_handler.c)
target_include_directories(app PRIVATE include)

# NORDIC SDK APP END
```

## prj.conf
```kconfig
CONFIG_NCS_SAMPLES_DEFAULTS=y

# Deffered logging helps improve LPN power consumption
# when friendship is established.
CONFIG_LOG_MODE_DEFERRED=y

# General configuration
CONFIG_SYSTEM_WORKQUEUE_STACK_SIZE=2048
CONFIG_FLASH=y
CONFIG_FLASH_MAP=y
CONFIG_NVS=y
CONFIG_SETTINGS=y
CONFIG_HWINFO=y
CONFIG_DK_LIBRARY=y
CONFIG_PM_SINGLE_IMAGE=y
CONFIG_PM_PARTITION_SIZE_SETTINGS_STORAGE=0x8000
CONFIG_SOC_FLASH_NRF_PARTIAL_ERASE=y

CONFIG_NEWLIB_LIBC=y

# Bluetooth configuration
CONFIG_BT=y
CONFIG_BT_COMPANY_ID=0x0059
CONFIG_BT_DEVICE_NAME="Mesh Distance Cli_Ser"
CONFIG_BT_L2CAP_TX_BUF_COUNT=8
CONFIG_BT_OBSERVER=y
CONFIG_BT_PERIPHERAL=y
CONFIG_BT_SETTINGS=y
# Increase RX stack size to avoid overflow during provisioning
CONFIG_BT_RX_STACK_SIZE=2700

# Disable unused Bluetooth features
CONFIG_BT_CTLR_DUP_FILTER_LEN=0
CONFIG_BT_CTLR_LE_ENC=n
CONFIG_BT_PHY_UPDATE=n
CONFIG_BT_CTLR_CHAN_SEL_2=n
CONFIG_BT_CTLR_MIN_USED_CHAN=n
CONFIG_BT_CTLR_PRIVACY=n

# Bluetooth mesh configuration 
CONFIG_BT_MESH=y
CONFIG_BT_MESH_RELAY=y
CONFIG_BT_MESH_FRIEND=y
CONFIG_BT_MESH_TX_SEG_MAX=32
CONFIG_BT_MESH_PB_GATT=y
CONFIG_BT_MESH_GATT_PROXY=y
CONFIG_BT_MESH_PROXY_USE_DEVICE_NAME=y
CONFIG_BT_MESH_DK_PROV=y

# Bluetooth mesh dm models
CONFIG_DM_MODULE=y
CONFIG_MPSL=y
CONFIG_MPSL_TIMESLOT_SESSION_COUNT=2
CONFIG_BT_MESH_DM_CLI=y
CONFIG_BT_MESH_DM_SRV=y

#Bluetooth mesh sensor models
CONFIG_BT_MESH_SENSOR_CLI=y
CONFIG_BT_MESH_SENSOR_USE_LEGACY_SENSOR_VALUE=n

#Bluetooth mesh shell commands
CONFIG_BT_MESH_SHELL=y
CONFIG_BT_MESH_SHELL_SENSOR_CLI=y
```

## boards/nrf5340dk_nrf5340_cpuapp.conf
```kconfig
#CONFIG_BT_RX_STACK_SIZE=4096 This was part of the default program

# Distance Measurement (copied from NRF_DM boards 5340dk conf)
CONFIG_DM_MODULE_RPC=y
CONFIG_DM_MODULE_RPC_CLIENT=y

CONFIG_TEST_RANDOM_GENERATOR=y
CONFIG_MPSL=n

# NRF RPC
CONFIG_NRF_RPC_THREAD_POOL_SIZE=2

#SYSTEM WORKQUEUE
CONFIG_SYSTEM_WORKQUEUE_STACK_SIZE=3072
```

## src/main.c
```c
/** @file
 *  @brief DM mesh client sample
 */
#include <zephyr/bluetooth/bluetooth.h>
#include <bluetooth/mesh/models.h>
#include <bluetooth/mesh/dk_prov.h>
#include <dk_buttons_and_leds.h>
#include "model_handler.h"

static void bt_ready(int err)
{
	if (err) {
		printk("Bluetooth init failed (err %d)\n", err);
		return;
	}

	printk("Bluetooth initialized\n");

	dk_leds_init();
	dk_buttons_init(NULL);

	err = bt_mesh_init(bt_mesh_dk_prov_init(), model_handler_init());
	if (err) {
		printk("Initializing mesh failed (err %d)\n", err);
		return;
	}

	if (IS_ENABLED(CONFIG_BT_MESH_LOW_POWER)) {
		bt_mesh_lpn_set(true);
	}

	if (IS_ENABLED(CONFIG_SETTINGS)) {
		settings_load();
	}

	/* This will be a no-op if settings_load() loaded provisioning info */
	bt_mesh_prov_enable(BT_MESH_PROV_ADV | BT_MESH_PROV_GATT);

	printk("Mesh initialized\n");
}

int main(void)
{
        int err;

	printk("Initializing...\n");

	err = bt_enable(bt_ready);
	if (err) {
		printk("Bluetooth init failed (err %d)\n", err);
	}

	return 0;
}
```

## include/Sensor_handler.h
```c
#ifndef SENSOR_HANDLER_H__
#define SENSOR_HANDLER_H__

#define GET_DATA_INTERVAL 60000
#define GET_DATA_INTERVAL_QUICK 3000

#include <zephyr/bluetooth/mesh.h>
#include <bluetooth/mesh/models.h>

//extern struct k_work_delayable get_data_work;

extern const int temp_ranges[4][2];

/*int setting_set_int(const struct bt_mesh_sensor_type *sensor_type,
			   const struct bt_mesh_sensor_type *setting_type,
			   const int *values);*/

void get_data(uint8_t buttion);

#endif /* SENSOR_HANDLER_H__ */
```

## include/distance_measurement_handler.h
```c
#ifndef DISTANCE_MEASUREMENT_HANDLER_H__
#define DISTANCE_MEASUREMENT_HANDLER_H__

#include <zephyr/bluetooth/mesh.h>
#include <dm.h>
#include <bluetooth/mesh/vnd/dm_cli.h>
#include <bluetooth/mesh/vnd/dm_srv.h>

/* Put functions, global structs, and variables here that will be used by model_handler */

/** Context for a single distance measurement client to issue a measurement start with a server. */
struct button {
	/** Generic dm client instance for this switch. */
	struct bt_mesh_dm_cli client;
};

struct led_ctx {
    struct bt_mesh_dm_srv srv;
};

void get_dm(struct bt_mesh_dm_cli *cli,
			struct bt_mesh_msg_ctx *ctx,
			struct bt_mesh_dm_cli_results *res,
			 uint8_t mes);



#endif /* DISTANCE_MEASUREMENT_HANDLER_H__ */
```

## include/model_handler.h
```c
/*
 * Copyright (c) 2019 Nordic Semiconductor ASA
 *
 * SPDX-License-Identifier: LicenseRef-Nordic-5-Clause
 */

/**
 * @file
 * @brief Model handler
 */

#ifndef MODEL_HANDLER_H__
#define MODEL_HANDLER_H__

#include <zephyr/bluetooth/mesh.h>
#include "distance_measurement_handler.h"

/*#ifdef __cplusplus
extern "C" {
#endif*/

const struct bt_mesh_comp *model_handler_init(void);
extern struct button distance_client_instances[6];
extern struct led_ctx distance_server_instances[1];
extern struct bt_mesh_sensor_cli sensor_cli;

/*#ifdef __cplusplus
}
#endif*/

#endif /* MODEL_HANDLER_H__ */
```

## src/Sensor_handler.c
```c
#include <zephyr/bluetooth/bluetooth.h>
#include "Sensor_handler.h"
#include "model_handler.h"

/* My Comment: This function is called anytime sensor sample data is received from a sensor server */
static void sensor_cli_data_cb(struct bt_mesh_sensor_cli *cli,
			       struct bt_mesh_msg_ctx *ctx,
			       const struct bt_mesh_sensor_type *sensor,
			       const struct bt_mesh_sensor_value *value)
{
	if (sensor->id == bt_mesh_sensor_present_dev_op_temp.id) {
		printk("Ambient temperature: %s\n", bt_mesh_sensor_ch_str(value));
	} 
	else if (sensor->id == bt_mesh_sensor_present_amb_rel_humidity.id) {
		printk("Ambient humidity: %s\n", bt_mesh_sensor_ch_str(value));
	}
	else if (sensor->id == bt_mesh_sensor_present_amb_light_level.id){
		printk("Ambient light level: %s\n", bt_mesh_sensor_ch_str(value));
	}
	/*else if (sensor->id ==
		   bt_mesh_sensor_time_since_presence_detected.id) {
		int64_t time_since_presence_detected = 0;
		enum bt_mesh_sensor_value_status status =
			bt_mesh_sensor_value_to_micro(value, &time_since_presence_detected);

		if (status == BT_MESH_SENSOR_VALUE_UNKNOWN) {
			printk("Unknown last presence detected\n");
		} else if (!time_since_presence_detected) {
			printk("Presence detected, or under 1 second since presence detected\n");
		} else {
			printk("%s second(s) since last presence detected\n",
			       bt_mesh_sensor_ch_str(value));
		}
	} else if (sensor->id == bt_mesh_sensor_present_amb_light_level.id) {
		printk("Ambient light level: %s\n", bt_mesh_sensor_ch_str(value));
	}*/
}

/* Any kind of series entry (like bt_mesh_sensor_cli_series_entry_get or bt_mesh_sensor_cli_series_entries_get) received will be handled here. */
/* I don't really know what a series entry is though.*/
/*static void sensor_cli_series_entry_cb(
	struct bt_mesh_sensor_cli *cli, struct bt_mesh_msg_ctx *ctx,
	const struct bt_mesh_sensor_type *sensor, uint8_t index, uint8_t count,
	const struct bt_mesh_sensor_series_entry *entry)
{
	printk("Relative runtime in %s", bt_mesh_sensor_ch_str(&entry->value[1]));
	printk(" to %s degrees: ", bt_mesh_sensor_ch_str(&entry->value[2]));
	printk("%s percent\n", bt_mesh_sensor_ch_str(&entry->value[0]));
}*/

/* Called when receiving a sensor setting status, which happens when we are calling the getting or setting function api*/
/*static void sensor_cli_setting_status_cb(struct bt_mesh_sensor_cli *cli,
					 struct bt_mesh_msg_ctx *ctx,
					 const struct bt_mesh_sensor_type *sensor,
					 const struct bt_mesh_sensor_setting_status *setting)
{
	printk("Sensor ID: 0x%04x, Setting ID: 0x%04x\n", sensor->id, setting->type->id);
	for (int chan = 0; chan < setting->type->channel_count; chan++) {
		printk("\tChannel %d value: %s\n", chan,
		       bt_mesh_sensor_ch_str(&(setting->value[chan])));
	}
}*/

/* Called when receiving sensor descriptors, which happens when calling bt_mesh_sensor_cli_all_get or bt_mesh_sensor_cli_desc_get. */
/* So it sounds like basic info about what kind of sensor is being used.*/
/*static void sensor_cli_desc_cb(struct bt_mesh_sensor_cli *cli, struct bt_mesh_msg_ctx *ctx,
			       const struct bt_mesh_sensor_info *sensor)
{
	printk("Descriptor of sensor with ID 0x%04x:\n", sensor->id);
	printk("\ttolerance: { positive: %d negative: %d }\n",
	       sensor->descriptor.tolerance.positive, sensor->descriptor.tolerance.negative);
	printk("\tsampling type: %d\n", sensor->descriptor.sampling_type);
}*/

static const struct bt_mesh_sensor_cli_handlers bt_mesh_sensor_cli_handlers = {
	.data = sensor_cli_data_cb,
	//.series_entry = sensor_cli_series_entry_cb,
	//.setting_status = sensor_cli_setting_status_cb,
	//.sensor = sensor_cli_desc_cb,
};

struct bt_mesh_sensor_cli sensor_cli = 
        BT_MESH_SENSOR_CLI_INIT(&bt_mesh_sensor_cli_handlers);

struct k_work_delayable get_data_work;

/* This function is called periodically. In the function it sends requests to the sensor to get specific data*/
void get_data(uint8_t button)
{
	int err;
	uint8_t button_value = button;
	if(button_value == 1){
		err = bt_mesh_sensor_cli_get(
				&sensor_cli, NULL, &bt_mesh_sensor_present_dev_op_temp,
				NULL);
		if (err) {
			printk("Error getting temperature (%d)\n", err);
		}
	}
	if(button_value == 2){
		err = bt_mesh_sensor_cli_get(
				&sensor_cli, NULL, &bt_mesh_sensor_present_amb_rel_humidity,
				NULL);
		if(err){
			printk("Error getting humidity data (%d)\n", err);
		}
	}
	if(button_value == 3){
		err = bt_mesh_sensor_cli_get(
				&sensor_cli, NULL, &bt_mesh_sensor_present_amb_light_level,
				NULL);
		if(err){
			printk("Error getting light data (%d)\n", err);
		}
	}
}

//Not needed get rid of later
const int temp_ranges[][2] = {
        {0, 100},
        {10, 20},
        {22, 30},
        {40, 50},
};

//static const int presence_motion_threshold[] = { 0, 25, 50, 75, 100 };

//Not needed get rid of later
/*int setting_set_int(const struct bt_mesh_sensor_type *sensor_type,
			   const struct bt_mesh_sensor_type *setting_type,
			   const int *values)
{
	struct bt_mesh_sensor_value sensor_vals[CONFIG_BT_MESH_SENSOR_CHANNELS_MAX];
	int err;

	for (int i = 0; i < setting_type->channel_count; i++) {
		err = bt_mesh_sensor_value_from_micro(setting_type->channels[i].format,
						      values[i] * 1000000LL, &sensor_vals[i]);
		if (err) {
			return err;
		}
	}

	return bt_mesh_sensor_cli_setting_set(&sensor_cli, NULL, sensor_type,
					      setting_type, sensor_vals, NULL);
}*/
```

## src/distance_measurement_handler.c
```c
#include <bluetooth/mesh/models.h>
#include <dk_buttons_and_leds.h>
#include <dm.h>
#include <bluetooth/mesh/vnd/dm_common.h>
#include <bluetooth/mesh/vnd/dm_cli.h>
#include <bluetooth/mesh/vnd/dm_srv.h>
#include "distance_measurement_handler.h"
#include "model_handler.h"
#include <string.h>

/*Hardcoded mesh device addresses. Can be found on the nRF Mesh app.*/
#define CLIENT 0x0010 // mesh app: F Client: 10
#define SENSOR 0x0008 // This value is a place holder value for the friend node DM server of the sensor
#define ANCHOR 0x1234 // Value to represent generic anchor
#define ANCHOR1 0x0002 
#define ANCHOR2 0x0003
#define ANCHOR3 0x0007 
#define MAX_REF_ENTRIES 1 //I had this at 1 before but I think this is effecting the multiple distance measurement calls with one button press

static void update_distance(const struct bt_mesh_dm_cli_results *results, struct bt_mesh_msg_ctx *ctx);

/* Global arrays for storing distances between client/sensor and the anchor nodes*/
float CA_Dist[3];
float AS_Dist[3];

/* Client and sensor flags used single hop distance measurement at the end */
bool DM_C_Flags[3];
bool DM_S_Flags[3];

/* Arrays for storing the two closest anchor nodes for the client and sensor */
uint8_t Closest_Anchor_Cli[2];
uint8_t Closest_Anchor_Sen[2];

/* Array to store which anchors the client and sensor have in common*/
uint8_t Anchors_Shared[2];

/* DM server model setup */
static struct bt_mesh_dm_res_entry meas;

static struct bt_mesh_dm_res_entry *measurements[] = {
    &meas,
};

/* Define the server instances */
struct led_ctx distance_server_instances[1] = {
    {.srv = BT_MESH_MODEL_DM_SRV_INIT(&meas, ARRAY_SIZE(measurements))},
};

static uint32_t Node_Addr_Origin(uint32_t Addr)
{
	uint32_t addr_of_start;
	uint32_t start = Addr;

	switch(start){
	case CLIENT: addr_of_start = CLIENT;
				 break;
	case ANCHOR1:
	case ANCHOR2:
	case ANCHOR3:
				 addr_of_start = ANCHOR;
				 break;
	default: addr_of_start = 0xFF;
	
	}
	return addr_of_start;
}

static uint32_t Node_Addr_Dest(uint32_t Addr)
{
	uint32_t addr_of_end;
	uint32_t end = Addr;

	switch(end){
	case ANCHOR1: addr_of_end = 0x01;
				   break;
	case ANCHOR2: addr_of_end = 0x02;
				   break;
	case ANCHOR3: addr_of_end = 0x03;
				   break;
	case SENSOR:  addr_of_end = SENSOR;
	default: addr_of_end = 0xFF;
	}
	return addr_of_end;
}

/* Used to find the two closest anchors to the client and sensor and storing it*/
static void Find_Two_Closest()
{
	// Two closest anchors for client *******************************************************
	float closest_c = 1000.0; // Just really large number that the distance could never be
	for(int i = 0; i < ARRAY_SIZE(CA_Dist); i++){
		if(CA_Dist[i] < closest_c){
			closest_c = CA_Dist[i];
			Closest_Anchor_Cli[0] = i;
		}
	}
	printk("Closest anchor to client: %d\n", Closest_Anchor_Cli[0] + 1);

	float second_closest_c = 1000.0;
	for(int i = 0; i < ARRAY_SIZE(CA_Dist); i++){
		if((CA_Dist[i] < second_closest_c) && (CA_Dist[i] > closest_c)){
			second_closest_c = CA_Dist[i];
			Closest_Anchor_Cli[1] = i;
		}
	}
	printk("Second closest anchor to client: %d\n", Closest_Anchor_Cli[1] + 1);

	// Two closest anchors for sensor ********************************************************
	float closest_s = 1000.0;
	for(int i = 0; i < ARRAY_SIZE(AS_Dist); i++){
		if(AS_Dist[i] < closest_s){
			closest_s = AS_Dist[i];
			Closest_Anchor_Sen[0] = i;
		}
	}
	printk("Closest anchor to sensor: %d\n", Closest_Anchor_Sen[0] + 1);

	float second_closest_s = 1000.0;
	for(int i = 0; i < ARRAY_SIZE(AS_Dist); i++){
		if((AS_Dist[i] < second_closest_s) && (AS_Dist[i] > closest_s)){
			second_closest_s = AS_Dist[i];
			Closest_Anchor_Sen[1] = i;
		}
	}
	printk("Second closest anchor to sensor: %d\n", Closest_Anchor_Sen[1] + 1);
}

static uint8_t FindCommonAnchors()
{
	uint8_t Common_Anchors = 0;
	for(int i = 0; i < ARRAY_SIZE(Closest_Anchor_Cli); i++){
		for(int j = 0; j < ARRAY_SIZE(Closest_Anchor_Sen); j++){
			if(Closest_Anchor_Cli[i] == Closest_Anchor_Sen[j]){
				Anchors_Shared[0] = Closest_Anchor_Cli[i];
				Common_Anchors++;
				break;
			}
		}
	}

	for(int i = 0; i < ARRAY_SIZE(Closest_Anchor_Cli); i++){
		for(int j = 0; j < ARRAY_SIZE(Closest_Anchor_Sen); j++){
			if((Closest_Anchor_Cli[i] == Closest_Anchor_Sen[j]) && (Closest_Anchor_Cli[i] != Anchors_Shared[0])){
				Anchors_Shared[1] = Closest_Anchor_Cli[i];
				Common_Anchors++;
			}
		}
	}
	return Common_Anchors;
}

static void print_result(const struct bt_mesh_dm_cli_results *results, struct bt_mesh_msg_ctx *ctx)
{
	uint32_t start = ctx->addr;
	uint32_t end = results->res->addr;
	uint32_t addr_of_start = Node_Addr_Origin(start);
	uint32_t addr_of_mid = Node_Addr_Dest(start);
	uint32_t addr_of_end = Node_Addr_Dest(end);
	uint8_t Common_Anchors;

	if(addr_of_start == CLIENT)
		printk("Distance from client to anchor%d: %.2f\n", addr_of_end, results->res->res.mcpd.best / 100.0);
	else if(addr_of_start == ANCHOR)
		printk("Distance from anchor%d to sensor: %.2f\n", addr_of_mid, results->res->res.mcpd.best / 100.0);
	else
		printk("Error!\n");
	//printk("Remote address: %x\n", ctx->addr); // This should be the address of the start_reflector device
	//printk("Unicast address of the node distance was measured with: %x\n", results->res->addr); //This should be the address of the start_initiator
	// I'm thinking I could use the two above addresses for checking which distance variable to update. If they are what I think they are.

	update_distance(results, ctx);

	bool client_ready = 1;
	for(int i = 0; i < ARRAY_SIZE(DM_C_Flags); i++){
		if(DM_C_Flags[i] != 1){
			client_ready = 0;
			break;

		}
	}

	bool sensor_ready = 1;
	for(int i = 0; i < ARRAY_SIZE(DM_S_Flags); i++){
		if(DM_S_Flags[i] != 1){
			sensor_ready = 0;
			break;
		}
	}

	if(client_ready && sensor_ready){
		//First get the two closest anchor nodes to the client and sensor
		Find_Two_Closest();

		//Next check if they share any of the nodes. 
		Common_Anchors = FindCommonAnchors();
		printk("The amount of anchors both share: %d\n", Common_Anchors);
		//If they share only one arnchor use it as the reference point for distance estimation.
		if(Common_Anchors == 1){
			printk("Estimated distance from client to server: %.2f\n", CA_Dist[Anchors_Shared[0]] + AS_Dist[Anchors_Shared[0]]);
		}
		else if(Common_Anchors == 2){ //If they share two anchors use the one closest to either the client or sensor
			float CA_Shared_Closest;
			float AS_Shared_Closest;
			uint8_t AnchorToUseCli;
			uint8_t AnchorToUseSen;

			if(CA_Dist[Anchors_Shared[0]] < CA_Dist[Anchors_Shared[1]]){
				CA_Shared_Closest = CA_Dist[Anchors_Shared[0]];
				AnchorToUseCli = Anchors_Shared[0];
			}
			else{
				CA_Shared_Closest = CA_Dist[Anchors_Shared[1]];
				AnchorToUseCli = Anchors_Shared[1];
			}

			if(AS_Dist[Anchors_Shared[0]] < AS_Dist[Anchors_Shared[1]]){
				AS_Shared_Closest = AS_Dist[Anchors_Shared[0]];
				AnchorToUseSen = Anchors_Shared[0];
			}
			else{
				AS_Shared_Closest = AS_Dist[Anchors_Shared[1]];
				AnchorToUseSen = Anchors_Shared[1];
			}

			if(CA_Shared_Closest < AS_Shared_Closest)
				printk("Estimated distance from client to sensor: %.2f\n", CA_Dist[AnchorToUseCli] + AS_Dist[AnchorToUseCli]);
			else
				printk("Estimated distance from client to sensor: %.2f\n", CA_Dist[AnchorToUseSen] + AS_Dist[AnchorToUseSen]);
		}
		else
		printk("Error finding common anchors.\n");
		
		/* Hard reset all flags and arrays used for DM*/
		memset(CA_Dist, 0, sizeof(CA_Dist));
		memset(AS_Dist, 0, sizeof(AS_Dist));

		memset(DM_C_Flags, 0, sizeof(DM_C_Flags));
		memset(DM_S_Flags, 0, sizeof(DM_S_Flags));

		memset(Closest_Anchor_Cli, 0, sizeof(Closest_Anchor_Cli));
		memset(Closest_Anchor_Sen, 0, sizeof(Closest_Anchor_Sen));

		memset(Anchors_Shared, 0, sizeof(Anchors_Shared));
	}
}

static void update_distance(const struct bt_mesh_dm_cli_results *results, struct bt_mesh_msg_ctx *ctx)
{
	uint32_t start = Node_Addr_Origin(ctx->addr);

	if((results->res->quality == DM_QUALITY_OK) && (start == CLIENT)){
		switch(results->res->addr){
			case ANCHOR1: CA_Dist[0] = (float) results->res->res.mcpd.best / 100.0;
						  DM_C_Flags[0] = 1;
						  printk("Distance from client to anchor1 value stored and flag set.\n");
						  break;
			case ANCHOR2: CA_Dist[1] = (float) results->res->res.mcpd.best / 100.0;
						  DM_C_Flags[1] = 1;
						  printk("Distance from client to anchor2 value stored and flag set.\n");
						  break;
			case ANCHOR3: CA_Dist[2] = (float) results->res->res.mcpd.best / 100.0;
			              DM_C_Flags[2] = 1;
						  printk("Distnace from client ot anchor3 value stored and flag set.\n");
						  break;
			default: printk("Error, unknown measurement path from client to anchor.\n");
		}
	}
	else if ((results->res->quality == DM_QUALITY_OK) && (start == ANCHOR)){
		switch (ctx->addr){
			case ANCHOR1: AS_Dist[0] = (float) results->res->res.mcpd.best / 100.0;
					      DM_S_Flags[0] = 1;
						  printk("Distance from anchor1 value stored and flag set.\n");
						  break;
			case ANCHOR2: AS_Dist[1] = (float) results->res->res.mcpd.best / 100.0;
						  DM_S_Flags[1] = 1;
						  printk("Distance from anchor2 value stored and flag set.\n");
						  break;
			case ANCHOR3: AS_Dist[2] = (float) results->res->res.mcpd.best / 100.0;
						  DM_S_Flags[2] = 1;
						  printk("Distance from anchor3 value stored and flag set.\n");
						  break;
			default: printk("Error, unknown measurement path from anchor to sensor.\n");
		}
	}
	else
		printk("Error updating distance measurement.\n");
}


static void cfg_status_handler(struct bt_mesh_dm_cli *cli, 
                struct bt_mesh_msg_ctx *ctx,
                const struct bt_mesh_dm_cli_cfg_status *status);

static void result_handler(struct bt_mesh_dm_cli *cli, 
                struct bt_mesh_msg_ctx *ctx,
                const struct bt_mesh_dm_cli_results *results);

struct bt_mesh_dm_cli_handlers dm_cli_handlers = {
    .cfg_status_handler = cfg_status_handler,
    .result_handler = result_handler,
};

/*DM client response setup*/
struct bt_mesh_dm_res_entry dm_res_entry;
struct bt_mesh_dm_res_entry dm_res_entry2;

/* Define the array of client instances */
struct button distance_client_instances[6] = {
    {.client = BT_MESH_MODEL_DM_CLI_INIT(&dm_res_entry, MAX_REF_ENTRIES, &dm_cli_handlers)},
	{.client = BT_MESH_MODEL_DM_CLI_INIT(&dm_res_entry2, MAX_REF_ENTRIES, &dm_cli_handlers)},
};

static void cfg_status_handler(struct bt_mesh_dm_cli *cli,
                struct bt_mesh_msg_ctx *ctx,
                const struct bt_mesh_dm_cli_cfg_status *status)
{
    // Not going to use bt_mesh_dm_cli_config so leave this blank for now.
}

/*Seems like this function will handle the results from the measurement. So after the measurement data has been calculated after calling  
*bt_mesh_dm_cli_measurement_start the response will pass the calculated data to this function.
*/
static void result_handler(struct bt_mesh_dm_cli *cli,
                struct bt_mesh_msg_ctx *ctx,
                const struct bt_mesh_dm_cli_results *results)
{
    if(results->entry_cnt > 0){
		if(results->res->err_occurred)
			printk("Error while measuring distance.\n");
		else{
			print_result(results, ctx);
		}
	}
}

/*Perform distance meaasurement using DM Mesh API*/
static struct bt_mesh_dm_cfg dm_cfg = {
	.ttl = 10,
	.timeout = 100, //Was 50 before
	.delay = 0 //Was 0 before
};

static struct bt_mesh_dm_cli_start start_param = {
	.reuse_transaction = false,
	.mode = DM_RANGING_MODE_MCPD,
	.addr = ANCHOR1,
	.cfg = &dm_cfg
};

static struct bt_mesh_dm_cli_start start_param2 = {
	.reuse_transaction = false,
	.mode = DM_RANGING_MODE_MCPD,
	.addr = ANCHOR2,
	.cfg = &dm_cfg
};

static struct bt_mesh_dm_cli_start start_param3 = {
	.reuse_transaction = false,
	.mode = DM_RANGING_MODE_MCPD,
	.addr = ANCHOR3,
	.cfg = &dm_cfg
};

static struct bt_mesh_dm_cli_start start_param4 = {
	.reuse_transaction = false,
	.mode = DM_RANGING_MODE_MCPD,
	.addr = SENSOR,
	.cfg = &dm_cfg
};

static void dm_config_n_start(struct bt_mesh_dm_cli *cli,
								struct bt_mesh_msg_ctx *ctx,
								struct bt_mesh_dm_cli_start start_param,
								struct bt_mesh_dm_cli_results *res)
{
	int err = bt_mesh_dm_cli_config(cli, ctx, &dm_cfg, NULL);
	if(err){
		printk("Failed to configure client: %d\n", err);
		return 0;
	}
	else{
		//printk("\nyou are here %p\n", ctx->addr);
		err = bt_mesh_dm_cli_measurement_start(cli, ctx, &start_param, res);
	}
}

void get_dm(struct bt_mesh_dm_cli *cli,
			struct bt_mesh_msg_ctx *ctx,
			struct bt_mesh_dm_cli_results *res,
		    uint8_t mes)
{
	switch(mes){
		case 0:	dm_config_n_start(cli, ctx, start_param, res);
				k_sleep(K_MSEC(300));
				break;
		case 1: dm_config_n_start(cli, ctx, start_param2, res);
				k_sleep(K_MSEC(300));
				break;
		case 2: dm_config_n_start(cli, ctx, start_param3, res);
				k_sleep(K_MSEC(300));
				break;
		case 3:
		case 4:
		case 5:
				dm_config_n_start(cli, ctx, start_param4, res);
				k_sleep(K_MSEC(300));
				break;
		default: printk("Error in get_dm!");
	}

	return 1;
}
```

## src/model_handler.c
```c
/**
 * @file
 * @brief Model handler for the distance model client.
 *
 */
#include <zephyr/bluetooth/bluetooth.h>
#include <zephyr/bluetooth/mesh/proxy.h>
#include <bluetooth/mesh/models.h>
#include <dk_buttons_and_leds.h>
#include "model_handler.h"
#include "distance_measurement_handler.h"
#include "Sensor_handler.h"

unsigned int counter = 0;

/* Used for storing the address of the client DM server */
struct bt_mesh_msg_ctx ctx1 = {
	.addr = 0x0010
};

/* Used for storing the address of the anchor1 (left) DM server*/
struct bt_mesh_msg_ctx ctx2 = {
	.addr = 0x0002
};

/* Used for storing the address of the anchor2 (middle) DM server*/
struct bt_mesh_msg_ctx ctx3 = {
	.addr = 0x0003
};

/* Used for storing the address of the anchor3 (right) DM server*/
struct bt_mesh_msg_ctx ctx4 = {
	.addr = 0x0007
};

static void button_handler_cb(uint32_t pressed, uint32_t changed)
{
	if (!bt_mesh_is_provisioned()) {
		return;
	}

	static uint32_t temp_idx;
	static uint32_t motion_threshold_idx;
	int err;
	struct bt_mesh_dm_cli_results res1;
	struct bt_mesh_dm_cli_results res2;

	if(pressed & changed & BIT(0)){
	//for (int i = 0; i < ARRAY_SIZE(distance_client_instances); ++i) {
		//if (!(pressed & changed & BIT(i))) {
			//continue;
		//}
		
		counter = counter % 6;
		switch(counter){
			/* First three cases perform distance measurements from client to anchors */
			case 0: get_dm(&distance_client_instances[0].client, &ctx1, &res1, 0);
					counter++;
					break;
			case 1: get_dm(&distance_client_instances[0].client, &ctx1, &res1, 1);
					counter++;
					break;
			case 2: get_dm(&distance_client_instances[0].client, &ctx1, &res1, 2);
					counter++;
					break;
			/* Last three cases perform distance measurements from anchors to sensor */
			case 3: get_dm(&distance_client_instances[0].client, &ctx2, &res1, 3);
					counter++;
					break; 
			case 4: get_dm(&distance_client_instances[0].client, &ctx3, &res1, 4);
					counter++;
					break;
			case 5: get_dm(&distance_client_instances[0].client, &ctx4, &res1, 5);
					counter++;
					break;
			
			default: printf("Error! Distance measurement request in model_handler not vaild.\n");
		}
	}
	//}
	if(pressed & changed & BIT(1)){
		uint8_t one = 1;
		get_data(one);
	}
	if(pressed & changed & BIT(2)){
		uint8_t two = 2;
		get_data(two);
	}
	if(pressed & changed & BIT(3)){
		uint8_t three = 3;
		get_data(three);
	}

}

/* Set up a repeating delayed work to blink the DK's LEDs when attention is
 * requested.
 */
static struct k_work_delayable attention_blink_work;
static bool attention;

static void attention_blink(struct k_work *work)
{
	static int idx;
	const uint8_t pattern[] = {
#if DT_NODE_EXISTS(DT_ALIAS(sw0))
		BIT(0),
#endif
#if DT_NODE_EXISTS(DT_ALIAS(sw1))
		BIT(1),
#endif
#if DT_NODE_EXISTS(DT_ALIAS(sw2))
		BIT(2),
#endif
#if DT_NODE_EXISTS(DT_ALIAS(sw3))
		BIT(3),
#endif
	};

	if (attention) {
		dk_set_leds(pattern[idx++ % ARRAY_SIZE(pattern)]);
		k_work_reschedule(&attention_blink_work, K_MSEC(30));
	} else {
		dk_set_leds(DK_NO_LEDS_MSK);
	}
}

static void attention_on(struct bt_mesh_model *mod)
{
    attention = true;
	k_work_reschedule(&attention_blink_work, K_NO_WAIT);
}

static void attention_off(struct bt_mesh_model *mod)
{
	/* Will stop rescheduling blink timer */
	attention = false;
}

static const struct bt_mesh_health_srv_cb health_srv_cb = {
	.attn_on = attention_on,
	.attn_off = attention_off,
};

static struct bt_mesh_health_srv health_srv = {
	.cb = &health_srv_cb,
};

BT_MESH_HEALTH_PUB_DEFINE(health_pub, 0);

static struct bt_mesh_elem elements[] = {
#if DT_NODE_EXISTS(DT_ALIAS(sw0))
	BT_MESH_ELEM(1,
		     BT_MESH_MODEL_LIST(
			     BT_MESH_MODEL_CFG_SRV,
			     BT_MESH_MODEL_HEALTH_SRV(&health_srv, &health_pub),
				 BT_MESH_MODEL_SENSOR_CLI(&sensor_cli)
				 ),
			BT_MESH_MODEL_LIST(
		     BT_MESH_MODEL_DM_CLI(&distance_client_instances[0].client))),
#endif
#if DT_NODE_EXISTS(DT_ALIAS(led0))
    BT_MESH_ELEM(2,
                BT_MESH_MODEL_NONE,
                BT_MESH_MODEL_LIST(
                    BT_MESH_MODEL_DM_SRV(&distance_server_instances[0].srv))),
#endif
/*#if DT_NODE_EXISTS(DT_ALIAS(sw1))
	BT_MESH_ELEM(3,
				BT_MESH_MODEL_NONE,
				BT_MESH_MODEL_LIST(
					BT_MESH_MODEL_DM_CLI(&distance_client_instances[1].client))),
#endif*/
};

static const struct bt_mesh_comp comp = {
	.cid = CONFIG_BT_COMPANY_ID,
	.elem = elements,
	.elem_count = ARRAY_SIZE(elements),
};

const struct bt_mesh_comp *model_handler_init(void)
{
	static struct button_handler button_handler = {
		.cb = button_handler_cb,
	};

	k_work_init_delayable(&attention_blink_work, attention_blink);
	//k_work_init_delayable(&get_data_work, get_data);

	dk_button_handler_add(&button_handler);
	//k_work_schedule(&get_data_work, K_MSEC(GET_DATA_INTERVAL));

	return &comp;
}
```
